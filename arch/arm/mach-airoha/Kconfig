## arch/arm/mach-airoha/Kconfig
```kconfig
if ARCH_AIROHA

config SYS_VENDOR
	default "airoha"

choice
	prompt "Airoha board select"

config TARGET_EN7523
	bool "Airoha EN7523 SoC"
	select CPU_V7A
	select ARMV7_SET_CORTEX_SMPEN
	select REGMAP
	help
	  The Airoha EN7523 family (en7523/en7529/en7562) is an ARM-based
	  SoCs with a dual-core CPU. It comes with Wi-Fi 5/6 support and
	  connectivity to Ethernet PHY, DDR, PCIe, USB, UART and VoIP.
	  With advanced hardware design, EN7523 provides high processing
	  performance and low power consumption.

config TARGET_AN7581
	bool "Airoha AN7581 SoC"
	select ARM64
	help
	  The Airoha EN7581 is a ARM-based SoC with a quad-core Cortex-A7
	  including NEON and GPU, Mali-450 graphics, several DDR3 options,
	  crypto engine, built-in Wi-Fi / Bluetooth combo chip, JPEG decoder,
	  video interfaces supporting HDMI and MIPI, and video codec support.
	  Peripherals include Gigabit Ethernet, switch, USB3.0 and OTG, PCIe,
	  I2S, PCM, S/PDIF, UART, SPI, I2C, IR TX/RX, and PWM.

config TARGET_AN7583
	bool "Airoha AN7583 SoC"
	select ARM64

endchoice

config AIROHA_HTTP_RECOVERY
	bool "Airoha HTTP recovery"
	default y
	select EVENT
	select BUTTON
	select BUTTON_GPIO
	select LED
	select LED_GPIO
	select LED_ACTIVITY
	select LED_SW_BLINK
	select CMD_DHCP
	select CMD_PING
	select CMD_HTTPD
	select HTTPD_DHCP_SERVER
	help
	  Provide the common lwIP, HTTP, DHCP, and diagnostic command set used by
	  Airoha recovery environments.

config AIROHA_UBI_ENV
	bool "Airoha UBI environment"
	select MTD
	select DM_MTD
	select MTD_UBI
	select UBI_BLOCK
	select CMD_MTD
	select CMD_UBI
	select CMD_UBI_RENAME
	select ENV_IS_IN_UBI
	select ENV_REDUNDANT
	select ENV_RELOC_GD_ENV_ADDR
	select ENV_OVERWRITE
	select ENV_VARS_UBOOT_RUNTIME_CONFIG
	help
	  Store the primary and redundant U-Boot environments in the common Airoha
	  UBI partition and expose the commands used by board recovery scripts.

config SYS_SOC
	default "en7523" if TARGET_EN7523
	default "an7581" if TARGET_AN7581
	default "an7583" if TARGET_AN7583

config SYS_BOARD
	default "en7523" if TARGET_EN7523
	default "an7581" if TARGET_AN7581
	default "an7583" if TARGET_AN7583

config SYS_CONFIG_NAME
	default "en7523" if TARGET_EN7523
	default "an7581" if TARGET_AN7581
	default "an7583" if TARGET_AN7583

endif
```

## configs/an7583_nokia_xg-040g-mf_defconfig
```kconfig
CONFIG_ARM=y
CONFIG_ARCH_AIROHA=y
CONFIG_AIROHA_UBI_ENV=y
CONFIG_POSITION_INDEPENDENT=y
CONFIG_BOOTDELAY=3
CONFIG_AUTOBOOT_KEYED=y
CONFIG_AUTOBOOT_MENU_SHOW=y
CONFIG_TARGET_AN7583=y
CONFIG_USE_PREBOOT=y
CONFIG_TEXT_BASE=0x81e00000
CONFIG_SYS_MALLOC_F_LEN=0x4000
CONFIG_NR_DRAM_BANKS=1
CONFIG_DM_GPIO=y
CONFIG_DEFAULT_DEVICE_TREE="an7583-nokia-xg-040g-mf"
CONFIG_SYS_LOAD_ADDR=0x81800000
CONFIG_BUILD_TARGET="u-boot.bin"
# CONFIG_EFI_LOADER is not set
CONFIG_FIT=y
CONFIG_FIT_VERBOSE=y
CONFIG_DEFAULT_FDT_FILE="an7583-nokia-xg-040g-mf.dtb"
CONFIG_LOGLEVEL=9
CONFIG_LOG=y
CONFIG_SYS_PBSIZE=1049
CONFIG_SYS_CONSOLE_IS_IN_ENV=y
# CONFIG_DISPLAY_BOARDINFO is not set
CONFIG_HUSH_PARSER=y
CONFIG_SYS_PROMPT="AN7583> "
CONFIG_SYS_MAXARGS=8
CONFIG_CMD_CPU=y
CONFIG_CMD_LICENSE=y
CONFIG_CMD_BOOTMENU=y
CONFIG_CMD_ASKENV=y
CONFIG_CMD_ERASEENV=y
CONFIG_CMD_ENV_FLAGS=y
CONFIG_CMD_RNG=y
CONFIG_CMD_STRINGS=y
CONFIG_CMD_DM=y
CONFIG_CMD_GPIO=y
CONFIG_CMD_GPT=y
CONFIG_CMD_MTD_MARKBAD=y
CONFIG_CMD_MTD_NAND_READ_TEST=y
CONFIG_CMD_MTD_NAND_WRITE_TEST=y
CONFIG_CMD_PART=y
CONFIG_CMD_TFTPSRV=y
CONFIG_CMD_RARP=y
CONFIG_CMD_CDP=y
CONFIG_CMD_SNTP=y
CONFIG_CMD_LINK_LOCAL=y
CONFIG_CMD_DNS=y
CONFIG_CMD_PXE=y
CONFIG_CMD_CACHE=y
CONFIG_CMD_UUID=y
CONFIG_CMD_HASH=y
CONFIG_CMD_SMC=y
CONFIG_ENV_SOURCE_FILE="an7583_nokia_xg-040g-mf"
# CONFIG_ENV_IS_IN_MTD is not set
# CONFIG_MMC is not set
CONFIG_MTD_SPI_NAND=y
CONFIG_MTD_UBI_FASTMAP=y
CONFIG_MTD_UBI_FASTMAP_AUTOCONVERT=1
# CONFIG_UBIFS_SILENCE_MSG is not set
# CONFIG_UBIFS_SILENCE_DEBUG_DUMP is not set
CONFIG_VERSION_VARIABLE=y
CONFIG_NETCONSOLE=y
CONFIG_NET_RANDOM_ETHADDR=y
CONFIG_BUTTON=y
CONFIG_BUTTON_GPIO=y
CONFIG_SYS_RELOC_GD_ENV_ADDR=y
CONFIG_SYS_RX_ETH_BUFFER=8
CONFIG_REGMAP=y
CONFIG_SYSCON=y
CONFIG_CLK=y
CONFIG_DMA=y
CONFIG_GPIO_HOG=y
CONFIG_LED=y
CONFIG_LED_BLINK=y
CONFIG_LED_GPIO=y
CONFIG_SPI_FLASH=y
CONFIG_SPI_FLASH_EON=y
CONFIG_SPI_FLASH_GIGADEVICE=y
CONFIG_SPI_FLASH_ISSI=y
CONFIG_SPI_FLASH_MACRONIX=y
CONFIG_SPI_FLASH_SPANSION=y
CONFIG_SPI_FLASH_STMICRO=y
CONFIG_SPI_FLASH_WINBOND=y
CONFIG_SPI_FLASH_MTD=y
CONFIG_AIROHA_ETH=y
CONFIG_DM_MDIO=y
CONFIG_CMD_MII=y
CONFIG_CMD_MDIO=y
CONFIG_MDIO_AIROHA=y
CONFIG_PCS_AIROHA_AN7583=y
CONFIG_PHY=y
CONFIG_PINCTRL=y
CONFIG_PINCTRL_AIROHA_AN7583=y
CONFIG_POWER_DOMAIN=y
CONFIG_DM_REGULATOR=y
CONFIG_DM_REGULATOR_FIXED=y
CONFIG_RAM=y
CONFIG_DM_SERIAL=y
CONFIG_SYS_NS16550=y
CONFIG_SPI=y
CONFIG_DM_SPI=y
CONFIG_AIROHA_SNFI_SPI=y
CONFIG_SHA512=y
CONFIG_PHY_AIROHA=y
CONFIG_PHY_AIROHA_EN8811=y
CONFIG_PHY_AIROHA_EN8811_EMBEDDED_FW=y
CONFIG_PHY_ANEG_TIMEOUT=10000
CONFIG_PHY_ETHERNET_ID=y
```

## configs/en7523_evb_defconfig
```kconfig
CONFIG_ARM=y
CONFIG_POSITION_INDEPENDENT=y
CONFIG_SYS_ARCH_TIMER=y
CONFIG_ARCH_AIROHA=y
CONFIG_AIROHA_UBI_ENV=y
CONFIG_TEXT_BASE=0x81E00000
CONFIG_SYS_MALLOC_F_LEN=0x4000
CONFIG_NR_DRAM_BANKS=1
CONFIG_DM_GPIO=y
CONFIG_DEFAULT_DEVICE_TREE="airoha/en7523-evb"
CONFIG_SYS_LOAD_ADDR=0x81800000
CONFIG_BUILD_TARGET="u-boot.bin"
CONFIG_FIT=y
CONFIG_FIT_VERBOSE=y
CONFIG_BOOTDELAY=3
CONFIG_DEFAULT_FDT_FILE="en7523-evb"
CONFIG_SYS_PBSIZE=1049
CONFIG_SYS_CONSOLE_IS_IN_ENV=y
# CONFIG_DISPLAY_BOARDINFO is not set
CONFIG_HUSH_PARSER=y
CONFIG_SYS_PROMPT="U-Boot> "
CONFIG_SYS_MAXARGS=8
CONFIG_CMD_BOOTZ=y
CONFIG_CMD_BOOTMENU=y
# CONFIG_CMD_ELF is not set
# CONFIG_CMD_XIMG is not set
CONFIG_CMD_BIND=y
CONFIG_CMD_GPIO=y
# CONFIG_CMD_SETEXPR is not set
CONFIG_CMD_MII=y
CONFIG_CMD_EXT4=y
CONFIG_CMD_FAT=y
CONFIG_CMD_FS_GENERIC=y
CONFIG_CMD_MTDPARTS=y
CONFIG_CMD_LOG=y
CONFIG_OF_UPSTREAM=y
# CONFIG_ENV_IS_IN_MTD is not set
CONFIG_ENV_SOURCE_FILE="en7523_rfb"
CONFIG_NET_RANDOM_ETHADDR=y
CONFIG_SYS_RX_ETH_BUFFER=8
CONFIG_CLK=y
CONFIG_DMA=y
CONFIG_LED=y
CONFIG_LED_GPIO=y
# CONFIG_MMC is not set
CONFIG_MTD_SPI_NAND=y
CONFIG_DM_MDIO=y
CONFIG_AIROHA_ETH=y
CONFIG_PHY=y
CONFIG_PINCTRL=y
CONFIG_PINCTRL_AIROHA_EN7523=y
CONFIG_RAM=y
CONFIG_DM_SERIAL=y
CONFIG_SYS_NS16550=y
CONFIG_SPI=y
CONFIG_DM_SPI=y
CONFIG_AIROHA_SNFI_SPI=y
# CONFIG_UBIFS_SILENCE_MSG is not set
CONFIG_SHA512=y
```

## drivers/net/phy/airoha/Kconfig
```kconfig
# SPDX-License-Identifier: GPL-2.0-only
menuconfig PHY_AIROHA
	bool "Airoha Ethernet PHYs support"

config PHY_AIROHA_EN8811
	bool "Airoha Ethernet EN8811H support"
	depends on PHY_AIROHA
	depends on SUPPORTS_FW_LOADER
	select FW_LOADER
	select PHY_COMMON_PROPS
	help
	  AIROHA EN8811H supported.
	  AIROHA AN8811HB supported.

config PHY_AIROHA_EN8811_EMBEDDED_FW
	bool "Airoha EN8811H embedded MD32 firmware"
	depends on PHY_AIROHA_EN8811
	help
	  Build the EN8811H MD32 firmware (v1.0.4, version 23051209) into
	  the U-Boot image instead of loading it at runtime through the
	  'en8811h_load_firmware' environment script.

	  This is needed on boards where no firmware source is available
	  in U-Boot, e.g. when entering Web recovery through the EN8811H
	  port.
```
